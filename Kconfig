## Kconfig
```kconfig
menu "Opentherm ESP32-S3 hardware"

# ESP32-S3FH4R2: 4 MB in-package flash, 2 MB quad PSRAM, native USB only.
# The platform switches below are not user-settable (no prompt), so they are
# selected here. PSRAM mode (quad vs. octal) lives in sdkconfig.overlay.
config OPENTHERM_S3FH4R2
    bool
    default y
    select PLATFORM_FLASHSIZE_4M
    select ENABLE_ESP32S3_USB_JTAG_ONLY

# Defaults match the OpenTherm_ESP32S3 adapter board, rev 4 (README.pdf):
# Ihor Melnyk adapter on PC817s, 2x DS18B20 on separate pins, BMP180 on I2C.
# Avoid strapping pins 0/3/45/46, USB 19/20 and flash/PSRAM 26-32.
config OT_TX_GPIO
    int "OpenTherm adapter TX (to boiler) GPIO"
    range 1 48
    default 13

config OT_RX_GPIO
    int "OpenTherm adapter RX (from boiler) GPIO"
    range 1 48
    default 12

config DS18B20_1_GPIO
    int "DS18B20 #1 (terminal J2) GPIO, -1 = none"
    range -1 48
    default 10

config DS18B20_2_GPIO
    int "DS18B20 #2 (terminal J3) GPIO, -1 = none"
    range -1 48
    default 11

config I2C_SDA_GPIO
    int "On-board BMP180 (GY-68) I2C SDA GPIO"
    range 0 48
    default 8

config I2C_SCL_GPIO
    int "On-board BMP180 (GY-68) I2C SCL GPIO"
    range 0 48
    default 9

config BUTTON_GPIO
    int "Service button GPIO (active low)"
    range 0 48
    default 0
    ---help---
        BOOT on the SuperMini. GPIO0 is a strapping pin: actions run on
        release only. For an enclosure prefer a non-strapping pin.

config LED_GPIO
    int "WS2812 status LED GPIO"
    range 0 48
    default 48

config LED_ORDER_GRB
    bool "Status LED expects GRB byte order (WS2812)"
    default y

config OT_TX_ACTIVE_LOW
    bool "TX pin is LOW when the OpenTherm line is active"
    default y
    ---help---
        ihormelnyk-style adapters: TX idle = HIGH, active = LOW.
        Board rev 4: GPIO13 = 1 opens U1 and pulls the line to ~6-7 V.

config OT_RX_ACTIVE_LOW
    bool "RX pin is LOW when the OpenTherm line is active"
    default n
    ---help---
        ihormelnyk-style adapters: RX active = HIGH.

endmenu

menu "Opentherm heating control"

config BOILER_POWER_W
    int "Boiler rated power, W (for the energy estimate)"
    default 18000

config HEAT_FLOW_MIN_X10
    int "Minimum flow setpoint while heating, 0.1 degC"
    default 250

config HEAT_FLOW_MAX_X10
    int "Maximum flow setpoint, 0.1 degC (radiators ~750, floor heating ~450)"
    default 750

config HEAT_FLOW_FALLBACK_X10
    int "Flow setpoint when the room sensor has failed, 0.1 degC"
    default 450

config HEAT_FROST_X10
    int "Frost protection room temperature, 0.1 degC"
    default 50

config HEAT_AWAY_X10
    int "Room temperature in 'leave' mode, 0.1 degC"
    default 160

config HEAT_DEFAULT_SET_X10
    int "Room setpoint before the first pairing, 0.1 degC"
    default 200

config HEAT_DEFAULT_TZ_MIN
    int "Time zone offset used until the cloud sends one, minutes"
    default 180

endmenu
```
